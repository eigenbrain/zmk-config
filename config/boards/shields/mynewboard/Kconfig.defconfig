## config/boards/shields/mynewboard/Kconfig.defconfig
```kconfig
# Copyright (c) 2020 Pete Johanson, Richard Jones
# SPDX-License-Identifier: MIT

if SHIELD_MYNEWKEYBOARD

config ZMK_KEYBOARD_NAME
	default "mynewboard"

endif
```

## config/boards/shields/mynewboard/Kconfig.shield
```kconfig
# Copyright (c) 2020 Pete Johanson, Richard Jones
# SPDX-License-Identifier: MIT

config SHIELD_MYNEWKEYBOARD
	def_bool $(shields_list_contains,mynewboard)
```
